## drivers/video/sprdfb/Kconfig
```kconfig
if FB
config FB_SC8825
	bool "SC8825 frame buffer support "
	depends on FB && ARCH_SC8825
	select FB_CFB_FILLRECT
	select FB_CFB_COPYAREA
	select FB_CFB_IMAGEBLIT
	help
          Frame buffer driver for sc8825 based boards.

config FB_SCX35
	bool "SC8830 frame buffer support "
	depends on FB && ARCH_SCX35 && (!ARCH_SCX30G)
	select FB_CFB_FILLRECT
	select FB_CFB_COPYAREA
	select FB_CFB_IMAGEBLIT
	help
          Frame buffer driver for sc8830 based boards.
config FB_SCX30G
	bool "SC8830G frame buffer support "
	depends on FB && ARCH_SCX30G
	select FB_CFB_FILLRECT
	select FB_CFB_COPYAREA
	select FB_CFB_IMAGEBLIT
	help
          Frame buffer driver for sc8830G based boards.

config FB_SCX15
	bool "SC7715 frame buffer support "
	depends on FB && ARCH_SCX15
	select FB_CFB_FILLRECT
	select FB_CFB_COPYAREA
	select FB_CFB_IMAGEBLIT
	help
          Frame buffer driver for sc7715 based boards.

config SPRD_FB_SIZE
	int "MB size for frame buffer, should larger or equal lcd_w*lcd_h*4*2"
	range 1 16
	default 8
	depends on FB_SC8825 || FB_SCX35 || FB_SCX15 || FB_SCX30G

config FB_LCD_HX8363_MCU
	bool "support HX8363 panel mcu"
	depends on FB_SC8825 || FB_SCX35 || FB_SCX15
	default n

config FB_LCD_HX8363_RGB_SPI
	bool "support HX8363 panel rgb spi"
	depends on FB_SC8825 || FB_SCX35 || FB_SCX15
	default n

config FB_LCD_VIVA_RGB_SPI
	bool "support VIVA panel rgb spi"
	depends on FB_SC8825 || FB_SCX35 || FB_SCX15
	default n

config FB_LCD_HX8369
	bool "support HX8369 panel"
	depends on FB_SC8825 || FB_SCX35
	default n

config FB_LCD_HX8369B_MIPI
	bool "support HX8369B MIPI panel"
	depends on FB_SC8825 || FB_SCX35 || FB_SCX30G
	default n
	
config FB_LCD_S6D77A1A01_MIPI
	bool "support S6D77A1A01 MIPI panel"
	depends on FB_SC8825 || FB_SCX35 || FB_SCX30G
	default n

config FB_LCD_HX8369B_MIPI_GRAND_NEO
	bool "support HX8369B MIPI panel for grand neo"
	depends on FB_SC8825 || FB_SCX35 || FB_SCX30G
	default n

config FB_LCD_S6D0139
	bool "support S6D0139 panel"
	depends on FB_SC8825 || FB_SCX35
	default n

config FB_LCD_NT35516_MIPI
	bool "support NT35516 mipi panel"
	depends on FB_SC8825 || FB_SCX35 || FB_SCX30G
	default n

config FB_LCD_DUMMY
	bool "support DUMMY panel"
	depends on FB_SC8825 || FB_SCX35 || FB_SCX30G
	default y

config FB_LCD_NT35502_MIPI
	bool "support NT35502 mipi panel"
	depends on FB_SC8825 || FB_SCX35 || FB_SCX30G
	default n

config FB_LCD_VX5B3D_MIPI
	bool "support VX5B3D mipi panel"
	depends on FB_SC8825 || FB_SCX35 || FB_SCX30G
	default n

config FB_LCD_ILI9486S1_MIPI
	bool "support ILI9486S1 mipi panel"
	depends on FB_SCX35 || FB_SCX15 || FB_SCX30G
	default n

config FB_LCD_NT35516_RGB_I2C
	bool "support NT35516 rgb (i2c) panel"
	depends on FB_SC8825 || FB_SCX35
	default n

config FB_LCD_NT35516_RGB_SPI
	bool "support NT35516 rgb (spi) panel"
	depends on FB_SC8825 || FB_SCX35 || FB_SCX15
	default n

config FB_LCD_NT35516_MCU
	bool "support NT35516 mcu panel"
	depends on FB_SC8825 || FB_SCX35 || FB_SCX15 || FB_SCX30G
	default n

config FB_LCD_NT35510_MIPI
	bool "support NT35510 mipi panel"
	depends on FB_SC8825 || FB_SCX35
	default n

config FB_LCD_NT35512_MIPI
	bool "support NT35512 mipi panel"
	depends on FB_SC8825 || FB_SCX35
	default n

config FB_LCD_OTM8018B_MIPI
	bool "support otm 8018b mipi panel"
	depends on FB_SC8825 || FB_SCX35
	default n

config FB_LCD_SSD2075_MIPI
	bool "support ssd2075 mipi panel"
	depends on FB_SC8825 || FB_SCX35
	default n

config FB_LCD_ILI9486
	bool "support ILI9486 mcu panel"
	depends on FB_SC8825 || FB_SCX35 || FB_SCX15
	default n

config FB_LCD_ILI9486_RGB_SPI
	bool "support ILI9486 rgb spi panel"
	depends on FB_SC8825 || FB_SCX35 || FB_SCX15
	default n

config FB_LCD_SC7798_RGB_SPI
        bool "support SC7798 rgb spi panel"
        depends on FB_SC8825 || FB_SCX35 || FB_SCX15
        default n

config FB_LCD_ILI9341
	bool "support ILI9341 mcu panel"
	depends on FB_SC8825 || FB_SCX35 || FB_SCX15
	default n

config FB_LCD_ST7789V_MCU
	bool "support ST7789V mcu panel"
	depends on FB_SC8825 || FB_SCX35 || FB_SCX15
	default n

config FB_LCD_NT51017_MIPI_LVDS
        bool "support nt51017 lvds panel"
        depends on FB_SC8825 || FB_SCX35
        default n

config FB_LCD_HX8369B_MIPI
	bool "support hx8369b mipi panel"
	depends on FB_SC8825 || FB_SCX35
	default n

config FB_LCD_OTM1283A_MIPI
	bool "support otm 1283a mipi panel"
	depends on FB_SC8825 || FB_SCX35
	default n

config FB_LCD_ILI9806E_MIPI
	bool "support ili9806e mipi panel"
	depends on FB_SC8825 || FB_SCX35
	default n

config FB_LCD_T8861_MIPI
	bool "support t8861 mipi panel"
	depends on FB_SC8825 || FB_SCX35
	default n

config FB_LCD_HX8379A_MIPI
	bool "support hx8379a mipi panel"
	depends on FB_SC8825 || FB_SCX35 || FB_SCX30G
	default n

config FB_LCD_HX8389C_MIPI
	bool "support hx8389c mipi panel"
	depends on FB_SC8825 || FB_SCX35 || FB_SCX30G
	default n

config FB_LCD_RESERVE_MEM
        bool "support FB reserve mem"
        depends on FB_SC8825 || FB_SCX35 || FB_SCX15 || FB_SCX30G
        default n

config FB_LCD_OVERLAY_SUPPORT
	bool "support lcd overlay"
	depends on FB_SC8825 || FB_SCX35 || FB_SCX15 || FB_SCX30G
	default n

config FB_VSYNC_SUPPORT
	bool "support wait for vsync io"
	depends on FB_SC8825 || FB_SCX35 || FB_SCX15 || FB_SCX30G
	default y

config FB_ESD_SUPPORT
	bool "support esd check"
	depends on FB_SC8825 || FB_SCX35 || FB_SCX30G
	default n

config FB_DYNAMIC_CLK_SUPPORT
	bool "support close clk dynamically"
	depends on FB_SC8825 || FB_SCX35 || FB_SCX30G
	default n

config FB_DYNAMIC_FREQ_SCALING
	bool "support change mipi clk/fps/dpi clk dynamically"
	depends on FB_SC8825 || FB_SCX35 || FB_SCX15 || FB_SCX30G
	default n

config FB_MMAP_CACHED
	bool "support fb_mmap with cach"
	depends on FB_SC8825 || FB_SCX35 ||FB_SCX15
	default n

config FB_LOW_RES_SIMU
	bool "support low resolution simulator"
	depends on FB_SC8825 || FB_SCX35 ||FB_SCX15 || FB_SCX30G
	default n

config LCD_ESD_RECOVERY
	bool "support esd detection for lcd"
	default n
	
config LCD_ESD_RECOVERY_BY_TSP
	bool "support lcd esd detection controlloed by TSP"
	default n

config FB_TRIPLE_FRAMEBUFFER
	bool "support triple buffer"
	depends on FB_SC8825 || FB_SCX35 ||FB_SCX15 || FB_SCX30G
	default y

config FB_BL_EVENT_CTRL
	bool "support esd detection for lcd"
	default n

config LCD_MIPI_CONTINOUS_CLK
	bool "support continous clock"
	default n

config SPRDFB_GEN_PANEL
	bool "support gen-panel"
	default n
	help
		support generic panel driver on sprdfb
endif
```
